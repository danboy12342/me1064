## prj.conf
```kconfig
CONFIG_AUXDISPLAY=y
CONFIG_ADC=y
CONFIG_GPIO=y
```

## boards/nucleo_l432kc.overlay
```dts
/ {
 lcd_screen: hd44780 {
 compatible = "hit,hd44780";
 mode = <4>; // Operating in 4-bit mode.
 register-select-gpios = <&gpioa 6 GPIO_ACTIVE_HIGH>; // LCD Register Select (RS)
GPIO PA6 to pin4
 enable-gpios = <&gpioa 7 GPIO_ACTIVE_HIGH>; // Enable to send commands GPIO PA7 to pin6
 data-bus-gpios = <0>, / An array of 8 GPIO pins. If this
 <0>, // operates on 4-bit mode we only
 <0>, // need to link the last 4 to GPIOs pins
 <0>,
<&gpioa 8 GPIO_ACTIVE_HIGH>, // GPIO PA8 to LCD pin11
 <&gpioa 11 GPIO_ACTIVE_HIGH>, // GPIO PA11 to LCD pin12
 <&gpiob 5 GPIO_ACTIVE_HIGH>, // GPIO PB5 to LCD pin13
 <&gpiob 4 GPIO_ACTIVE_HIGH>; // GPIO PB4 to LCD pin14
 columns = <16>; // LCD number of columns
 rows = <2>; // LCD number of rows
 };
};

/* Enable and configure the ADC */
&adc1 {
    status = "okay";
    st,adc-clock-source = "SYNC";
    st,adc-prescaler = <1>;
    #address-cells = <1>;
    #size-cells = <0>;
    
    channel_5: channel@5 {  // Channel 5 linked to pin PA0
        reg = <5>;
        zephyr,gain = "ADC_GAIN_1";
        zephyr,reference = "ADC_REF_INTERNAL";
        zephyr,acquisition-time = <ADC_ACQ_TIME_DEFAULT>;
        zephyr,resolution = <12>;
    };
};
```

## src/main.c
```c
/*
Program 8: Display a voltage to an LCD display
Description: 
Course: 1064
Author: Daniel Mui
Date: 16/2/2026
 */

 //import tarrifs
#include <zephyr/device.h>
#include <zephyr/drivers/gpio.h>
#include <zephyr/drivers/auxdisplay.h>
#include <zephyr/drivers/adc.h>
#include <stdio.h>
#include <string.h> 

//make lcd device
static const struct device *const lcd_display = DEVICE_DT_GET(DT_NODELABEL(lcd_screen));

//,aeke adc device
static const struct device *const adc_dev1 = DEVICE_DT_GET(DT_NODELABEL(adc1));

// Create variable adc_ch1_cfg with the conf <-- Overlay
static const struct adc_channel_cfg adc_ch1_cfg = ADC_CHANNEL_CFG_DT(
    DT_CHILD(DT_NODELABEL(adc1), channel_5)
);

int main() { //big boy loops now
    // Initialise
    adc_channel_setup(adc_dev1, &adc_ch1_cfg);
    auxdisplay_clear(lcd_display);
    
    //seq for mesurement
    uint16_t buf;
    struct adc_sequence sequence = {
        .channels = BIT(5),        // ch.5
        .buffer = &buf,
        .buffer_size = sizeof(buf),
        .resolution = 12
    };
    
    char msg1[64]; // Create a char var
    
    while(1){ 
        auxdisplay_clear(lcd_display); //clear it

        adc_read(adc_dev1, &sequence); // Read

        int voltage = buf * 3300/4095; // Convert and write
        snprintf(msg1, sizeof(msg1), "Voltage is: %d mV", voltage);
        auxdisplay_write(lcd_display, msg1, strlen(msg1) );

        k_sleep(K_MSEC(200));
    }
    //safe code is a lie told by big code to sell more code
}
```
